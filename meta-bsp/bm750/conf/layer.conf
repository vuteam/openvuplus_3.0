## meta-bsp/bm750/conf/layer.conf
```bitbake
BBFILES += "${LAYERDIR}/recipes/*/*.bb"
BBFILES += "${LAYERDIR}/recipes/*/*.bbappend"
BBPATH .= ":${LAYERDIR}"
BBFILE_COLLECTIONS += "bm750"
BBFILE_PRIORITY_bm750 = "40"
BBFILE_PATTERN_bm750 := "^${LAYERDIR}/"
```

## meta-bsp/bm750/conf/machine/bm750.conf
```bitbake
#@TYPE: Machine
#@NAME: Vu+ Duo
#@DESCRIPTION: Machine configuration for Vu+ Duo.

VUPLUS_FEATURES += "vuwlan"
VUPLUS_FEATURES += "display-text-vfd"
VUPLUS_FEATURES += "fan_simple"
VUPLUS_FEATURES += "hbbtv"
VUPLUS_FEATURES += "streamtv"
VUPLUS_FEATURES += "dlna"
VUPLUS_FEATURES += "3gmodem"
VUPLUS_FEATURES += "audioeffect"

IMAGE_UNPACK_PATH = "vuplus/duo"
MKFS_UBI_MAX_ERASE_BLK_COUNT = "4096"

require conf/machine/include/vuplus-ubi.inc
require conf/machine/include/vuplus-mips32el.inc
```

## meta-bsp/common/conf/machine/include/vuplus-mips32el.inc
```bitbake
# vuplus-mips32el.inc

VUPLUS_KERNEL_VERSION ?= "3.1.1"
LINUXLIBCVERSION ?= "3.1"

TARGET_ARCH = "mipsel"
DEFAULTTUNE = "mips32el"

require conf/machine/include/vuplus.inc
require conf/machine/include/tune-mips32.inc
```

## meta-bsp/common/conf/machine/include/vuplus.inc
```bitbake
# vuplus.inc

GLIBC_EXTRA_OECONF = "--with-tls --with-__thread"

MACHINE_ESSENTIAL_EXTRA_RDEPENDS += "kernel"
MACHINE_ESSENTIAL_EXTRA_RDEPENDS += "vuplus-bootlogo"
MACHINE_ESSENTIAL_EXTRA_RDEPENDS += "vuplus-dvb-modules"
MACHINE_ESSENTIAL_EXTRA_RDEPENDS += "task-vuplus-essential"
MACHINE_FEATURES += "kernel26 alsa pci wifi vuwlan"

PREFERRED_PROVIDER_virtual/kernel = "linux-vuplus"

PREFERRED_VERSION_linux-vuplus = "${VUPLUS_KERNEL_VERSION}"

KERNEL_IMAGETYPE = "vmlinux"
KERNEL_OUTPUT = "${KERNEL_IMAGETYPE}"

EXTRA_IMAGEDEPENDS += "vuplus-makenfi-native"
```

## meta-bsp/conf/layer.conf
```bitbake
BBFILES += "${LAYERDIR}/recipes-*/*/*.bb ${LAYERDIR}/recipes-*/*/*.bbappend"
BBPATH .= ":${LAYERDIR}"
BBFILE_COLLECTIONS += "meta-bsp"
BBFILE_PRIORITY_meta-bsp = "30"
BBFILE_PATTERN_meta-bsp := "^${LAYERDIR}/"

SIGGEN_EXCLUDERECIPES_ABISAFE += " \
  vuplus-bootlogo \
"
```

## meta-bsp/conf/machine/include/vuplus-mips32el.inc
```bitbake
# vuplus-mips32el.inc

VUPLUS_KERNEL_VERSION ?= "3.13.5"

TARGET_ARCH = "mipsel"
DEFAULTTUNE = "mips32el"

require conf/machine/include/vuplus.inc
require conf/machine/include/tune-mips32.inc
```

## meta-bsp/conf/machine/include/vuplus.inc
```bitbake
# vuplus.inc

GLIBC_EXTRA_OECONF = "--with-tls --with-__thread"

MACHINE_ESSENTIAL_EXTRA_RDEPENDS += "kernel-image"
MACHINE_ESSENTIAL_EXTRA_RDEPENDS += "vuplus-bootlogo"
MACHINE_ESSENTIAL_EXTRA_RDEPENDS += "${@base_contains("VUPLUS_FEATURES", "dvbproxy", "vuplus-dvb-proxy", "vuplus-dvb-modules", d)}"
MACHINE_FEATURES += "kernel26 alsa pci wifi"

MACHINE_FEATURES_BACKFILL_CONSIDERED = "rtc"

PREFERRED_PROVIDER_virtual/kernel = "linux-vuplus-${MACHINE}"

PREFERRED_VERSION_linux-vuplus-${MACHINE} = "${VUPLUS_KERNEL_VERSION}"

KERNEL_IMAGETYPE = "vmlinux"
KERNEL_OUTPUT = "${KERNEL_IMAGETYPE}"

EXTRA_IMAGEDEPENDS += "vuplus-makenfi-native"
```

## meta-bsp/vuduo2/conf/layer.conf
```bitbake
BBFILES += "${LAYERDIR}/recipes/*/*.bb"
BBFILES += "${LAYERDIR}/recipes/*/*.bbappend"
BBPATH .= ":${LAYERDIR}"
BBFILE_COLLECTIONS += "vuduo2"
BBFILE_PRIORITY_vuduo2 = "40"
BBFILE_PATTERN_vuduo2 := "^${LAYERDIR}/"
```

## meta-bsp/vuduo2/conf/machine/vuduo2.conf
```bitbake
#@TYPE: Machine
#@NAME: Vu+ duo2
#@DESCRIPTION: Machine configuration for Vu+ duo2.

MACHINE_FEATURES += "display-graphic-vfd"
MACHINE_FEATURES += "enable-rc-kbd"
VUPLUS_FEATURES = "fan_manual rc_code "

VUPLUS_FEATURES += "firmwareupgrade"
VUPLUS_FEATURES += "blindscan"
VUPLUS_FEATURES += "hbbtv"
VUPLUS_FEATURES += "streamtv"
VUPLUS_FEATURES += "dlna"
VUPLUS_FEATURES += "3gmodem"
VUPLUS_FEATURES += "webif"

IMAGE_UNPACK_PATH = "vuplus/duo2"
MKFS_UBI_MAX_ERASE_BLK_COUNT = "4096"

require conf/machine/include/vuplus-ubi-initrd.inc
require conf/machine/include/vuplus-mips32el.inc

VUPLUS_KERNEL_VERSION = "2.6.37"
LINUXLIBCVERSION = "2.6.31"
```

## meta-bsp/vusolo/conf/layer.conf
```bitbake
BBFILES += "${LAYERDIR}/recipes/*/*.bb"
BBFILES += "${LAYERDIR}/recipes/*/*.bbappend"
BBPATH .= ":${LAYERDIR}"
BBFILE_COLLECTIONS += "vusolo"
BBFILE_PRIORITY_vusolo = "40"
BBFILE_PATTERN_vusolo := "^${LAYERDIR}/"
```

## meta-bsp/vusolo/conf/machine/vusolo.conf
```bitbake
#@TYPE: Machine
#@NAME: Vu+ Solo
#@DESCRIPTION: Machine configuration for Vu+ Solo.

VUPLUS_FEATURES += "vuwlan"
VUPLUS_FEATURES += "streamtv"
VUPLUS_FEATURES += "dlna"
VUPLUS_FEATURES += "3gmodem"
VUPLUS_FEATURES += "audioeffect"

IMAGE_UNPACK_PATH = "vuplus/solo"
MKFS_UBI_MAX_ERASE_BLK_COUNT = "4096"

require conf/machine/include/vuplus-ubi.inc
require conf/machine/include/vuplus-mips32el.inc
```

## meta-bsp/vusolo2/conf/layer.conf
```bitbake
BBFILES += "${LAYERDIR}/recipes/*/*.bb"
BBFILES += "${LAYERDIR}/recipes/*/*.bbappend"
BBPATH .= ":${LAYERDIR}"
BBFILE_COLLECTIONS += "vusolo2"
BBFILE_PRIORITY_vusolo2 = "40"
BBFILE_PATTERN_vusolo2 := "^${LAYERDIR}/"
```

## meta-bsp/vusolo2/conf/machine/vusolo2.conf
```bitbake
#@TYPE: Machine
#@NAME: Vu+ solo2
#@DESCRIPTION: Machine configuration for Vu+ solo2.

MACHINE_FEATURES += "display-text-vfd"
MACHINE_FEATURES += "enable-rc-kbd"
VUPLUS_FEATURES = "fan_manual rc_code "

VUPLUS_FEATURES += "firmwareupgrade"
VUPLUS_FEATURES += "webmanual"
VUPLUS_FEATURES += "hbbtv"
VUPLUS_FEATURES += "streamtv"
VUPLUS_FEATURES += "dlna"
VUPLUS_FEATURES += "3gmodem"
VUPLUS_FEATURES += "webif"
VUPLUS_FEATURES += "autoshutdown"
VUPLUS_FEATURES += "transcoding"

IMAGE_UNPACK_PATH = "vuplus/solo2"
MKFS_UBI_MAX_ERASE_BLK_COUNT = "4096"

require conf/machine/include/vuplus-ubi-splash-initrd.inc
require conf/machine/include/vuplus-mips32el.inc

VUPLUS_KERNEL_VERSION = "3.3.6"
LINUXLIBCVERSION = "2.6.31"
```

## meta-bsp/vusolose/conf/layer.conf
```bitbake
BBFILES += "${LAYERDIR}/recipes/*/*.bb"
BBFILES += "${LAYERDIR}/recipes/*/*.bbappend"
BBPATH .= ":${LAYERDIR}"
BBFILE_COLLECTIONS += "vusolose"
BBFILE_PRIORITY_vusolose = "40"
BBFILE_PATTERN_vusolose := "^${LAYERDIR}/"
```

## meta-bsp/vuultimo/conf/layer.conf
```bitbake
BBFILES += "${LAYERDIR}/recipes/*/*.bb"
BBFILES += "${LAYERDIR}/recipes/*/*.bbappend"
BBPATH .= ":${LAYERDIR}"
BBFILE_COLLECTIONS += "vuultimo"
BBFILE_PRIORITY_vuultimo = "40"
BBFILE_PATTERN_vuultimo := "^${LAYERDIR}/"
```

## meta-bsp/vuultimo/conf/machine/vuultimo.conf
```bitbake
#@TYPE: Machine
#@NAME: Vu+ ultimo
#@DESCRIPTION: Machine configuration for Vu+ ultimo.

VUPLUS_FEATURES += "vuwlan"
VUPLUS_FEATURES += "display-graphic-vfd"
VUPLUS_FEATURES += "right-half-vfd-skin"
VUPLUS_FEATURES += "enable-rc-kbd"
VUPLUS_FEATURES += "fan_manual rc_code led"

VUPLUS_FEATURES += "blindscan"
VUPLUS_FEATURES += "firmwareupgrade"
VUPLUS_FEATURES += "hbbtv"
VUPLUS_FEATURES += "streamtv"
VUPLUS_FEATURES += "dlna"
VUPLUS_FEATURES += "3gmodem"
VUPLUS_FEATURES += "vuplus-fpga-update"
VUPLUS_FEATURES += "ralink-kmod"
VUPLUS_FEATURES += "ralink-legacy"

IMAGE_UNPACK_PATH = "vuplus/ultimo"
MKFS_UBI_MAX_ERASE_BLK_COUNT = "3894"

require conf/machine/include/vuplus-ubi-splash.inc
require conf/machine/include/vuplus-mips32el.inc
```

## meta-bsp/vuuno/conf/layer.conf
```bitbake
BBFILES += "${LAYERDIR}/recipes/*/*.bb"
BBFILES += "${LAYERDIR}/recipes/*/*.bbappend"
BBPATH .= ":${LAYERDIR}"
BBFILE_COLLECTIONS += "vuuno"
BBFILE_PRIORITY_vuuno = "40"
BBFILE_PATTERN_vuuno := "^${LAYERDIR}/"
```

## meta-bsp/vuuno/conf/machine/vuuno.conf
```bitbake
#@TYPE: Machine
#@NAME: Vu+ Uno
#@DESCRIPTION: Machine configuration for Vu+ Uno.

MACHINE_FEATURES += "display-text-vfd"
MACHINE_FEATURES = "fan_manual rc_code"

MACHINE_FEATURES += "blindscan"
MACHINE_FEATURES += "hbbtv"
MACHINE_FEATURES += "streamtv"
MACHINE_FEATURES += "dlna"
MACHINE_FEATURES += "3gmodem"
MACHINE_FEATURES += "fpgaupgrade"
MACHINE_FEATURES += "vuplus-fpga-update"

IMAGE_UNPACK_PATH = "vuplus/uno"
MKFS_UBI_MAX_ERASE_BLK_COUNT = "4096"

require conf/machine/include/vuplus-ubi-splash.inc
require conf/machine/include/vuplus-mips32el.inc
```
