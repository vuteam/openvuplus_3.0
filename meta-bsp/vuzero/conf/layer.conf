## meta-bsp/vuzero/conf/layer.conf
```bitbake
BBFILES += "${LAYERDIR}/recipes/*/*.bb"
BBFILES += "${LAYERDIR}/recipes/*/*.bbappend"
BBPATH .= ":${LAYERDIR}"
BBFILE_COLLECTIONS += "vuzero"
BBFILE_PRIORITY_vuzero = "40"
BBFILE_PATTERN_vuzero := "^${LAYERDIR}/"
```
